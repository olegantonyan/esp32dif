## components/digi/Kconfig
```kconfig
menu "Board Digi+ (WM8804)"

    config APP_DIGI_ADDR
        hex "WM8804 I2C address"
        default 0x3B
        range 0x3A 0x3B

    config APP_DIGI_XTAL_HZ
        int "WM8804 crystal (Hz)"
        default 27000000
        range 10000000 27000000
        help
            'digi probe' measures it.

    config APP_DIGI_BCLK
        int "I2S BCLK GPIO (input, driven by the WM8804)"
        default 24

    config APP_DIGI_WS
        int "I2S WS / LRCLK GPIO (input, driven by the WM8804)"
        default 23

    config APP_DIGI_DOUT
        int "I2S data GPIO (output to the WM8804)"
        default 4

    config APP_DIGI_SPDIF_MON
        int "S/PDIF monitor GPIO (input, optional)"
        default 5
        help
            Wire the WM8804 TX0 pin (17) or the optical transmitter's data input here for 'digi spdif'.

    config APP_DIGI_BOOT_TONE_HZ
        int "Test tone at boot (Hz, 0 = silence)"
        default 440
        range 0 20000

    config APP_DIGI_BOOT_TONE_LEVEL
        int "Test tone level at boot (% of full scale)"
        default 10
        range 0 100

endmenu
```

## components/i2c_bus/Kconfig
```kconfig
menu "Board I2C bus"

    config APP_I2C_SDA
        int "SDA GPIO"
        default 8

    config APP_I2C_SCL
        int "SCL GPIO"
        default 9

endmenu
```

## components/ir/Kconfig
```kconfig
menu "Board IR receiver"

    config APP_IR_GPIO
        int "IR receiver output GPIO"
        default 10
        help
            Demodulated output of a 38 kHz IR receiver (idles high). GPIO10 is J1 pin 11 on ESP32-C5-DevKitC-1.

endmenu
```

## components/led/Kconfig
```kconfig
menu "Board LED"

    config APP_LED_GPIO
        int "RGB LED GPIO"
        default 27
        help
            Addressable (WS2812) RGB LED data pin. GPIO27 on ESP32-C5-DevKitC-1.

endmenu
```

## components/net/Kconfig
```kconfig
menu "Board network"

    config APP_NET_HOSTNAME
        string "Hostname (DHCP and mDNS, <name>.local)"
        default "esp32dif"

    config APP_NET_INSTANCE
        string "mDNS instance name"
        default "esp32dif S/PDIF receiver"

    config APP_NET_5G_PREFER_DB
        int "Prefer a 5 GHz AP within this many dB of the best 2.4 GHz one"
        range 0 60
        default 20
        help
            Applies with band auto (the default) when one SSID is on both bands.

    config APP_NET_AP_FALLBACK_S
        int "Start the fallback AP after this many seconds without an IP (at once with no saved network)"
        range 0 3600
        default 60

    config APP_NET_AP_LINGER_S
        int "Stop the fallback AP once the client has kept its IP this many seconds"
        range 0 3600
        default 120

    config APP_NET_AP_MAX_CONN
        int "Fallback AP clients"
        range 1 10
        default 4

endmenu
```

## components/oled/Kconfig
```kconfig
menu "Board OLED"

    config APP_OLED_SDA
        int "SDA GPIO"
        default 8

    config APP_OLED_SCL
        int "SCL GPIO"
        default 9

    config APP_OLED_ADDR
        hex "I2C address"
        default 0x3C
        range 0x3C 0x3D
        help
            SSD1306 address: 0x3C on most modules, 0x3D when the module's address jumper is moved.

    choice APP_OLED_HEIGHT_CHOICE
        prompt "Display height"
        default APP_OLED_HEIGHT_64
        help
            0.96" modules are 128x64; 0.91" ones are 128x32.

        config APP_OLED_HEIGHT_64
            bool "64 px"
        config APP_OLED_HEIGHT_32
            bool "32 px"
    endchoice

    config APP_OLED_HEIGHT
        int
        default 64 if APP_OLED_HEIGHT_64
        default 32 if APP_OLED_HEIGHT_32

endmenu
```

## components/remote/Kconfig
```kconfig
menu "Board IR remote"

    config APP_REMOTE_PORT
        int "TCP port for remote control clients"
        range 1 65535
        default 5005

endmenu
```

## components/rtp/Kconfig
```kconfig
menu "Board RTP receiver"

    config APP_RTP_PORT
        int "UDP port"
        range 1024 65535
        default 5004

    config APP_RTP_SAP_PORT
        int "SAP port: stream format comes from the sender's SAP/SDP announcement"
        range 1024 65535
        default 9875

    config APP_RTP_IDLE_MS
        int "A stream counts as stopped after this many ms without packets"
        range 100 60000
        default 2000

    config APP_RTP_LATENCY_MS
        int "Target buffer level (ms): playback latency, covers Wi-Fi gaps up to this long"
        range 10 2000
        default 250

    config APP_RTP_PSRAM_BUFFER_KB
        int "Playback buffer in PSRAM (KB): 1152 KB holds 1 s of 192 kHz L24 stereo"
        range 64 4096
        default 1152

    config APP_RTP_BUFFER_KB
        int "Playback buffer in internal RAM when there is no PSRAM (KB)"
        range 16 256
        default 64

endmenu
```

## components/settings/Kconfig
```kconfig
menu "Board settings"

    config APP_DEFAULT_PASSWORD
        string "Default password for the web UI, telnet, the fallback AP and RTP senders (8-63 characters)"
        default "esp32dif-admin"

endmenu
```

## components/telnet/Kconfig
```kconfig
menu "Board telnet"

    config APP_TELNET_PORT
        int "Port"
        range 1 65535
        default 23

    config APP_TELNET_IDLE_S
        int "Idle timeout (s), 0 to disable"
        range 0 86400
        default 600

endmenu
```

## sdkconfig.defaults
```kconfig
CONFIG_IDF_TARGET="esp32c5"
CONFIG_ESPTOOLPY_FLASHSIZE_8MB=y
CONFIG_PARTITION_TABLE_CUSTOM=y
CONFIG_PARTITION_TABLE_CUSTOM_FILENAME="partitions.csv"
CONFIG_BOOTLOADER_APP_ROLLBACK_ENABLE=y

CONFIG_ESP_CONSOLE_USB_SERIAL_JTAG=y
CONFIG_ESP_CONSOLE_SECONDARY_NONE=y

CONFIG_FREERTOS_USE_TRACE_FACILITY=y
CONFIG_FREERTOS_GENERATE_RUN_TIME_STATS=y

CONFIG_ESP_MAIN_TASK_STACK_SIZE=4096
CONFIG_BOOTLOADER_LOG_LEVEL_WARN=y

CONFIG_LWIP_UDP_RECVMBOX_SIZE=32
CONFIG_SPIRAM=y
CONFIG_SPIRAM_USE_CAPS_ALLOC=y

CONFIG_LIBC_NEWLIB=y
CONFIG_LWIP_MAX_SOCKETS=16

CONFIG_APP_OLED_HEIGHT_32=y
```
